## arch/arm/configs/selinux_defconfig
```kconfig
CONFIG_AUDIT=y
# CONFIG_AUDITSYSCALL is not set
CONFIG_DEFAULT_SECURITY_DAC=y
CONFIG_DEFAULT_SECURITY=""
CONFIG_DEFAULT_SECURITY_SELINUX=y
CONFIG_EXT4_FS_SECURITY=y
CONFIG_EXT4_FS_XATTR=y
CONFIG_IP_NF_SECURITY=y
CONFIG_LSM_MMAP_MIN_ADDR=4096
CONFIG_NETFILTER_ADVANCED=y
CONFIG_SECURITY=y
CONFIG_SECURITY_NETWORK=y
#CONFIG_SECURITY_SELINUX=y
#CONFIG_SECURITY_SELINUX_AVC_STATS=y
#CONFIG_SECURITY_SELINUX_CHECKREQPROT_VALUE=1
#CONFIG_SECURITY_SELINUX_DEVELOP=y
```
